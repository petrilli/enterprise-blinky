## CMakeLists.txt
```
cmake_minimum_required(VERSION 3.20.0)
set(CMAKE_C_STANDARD 23)

# Add our custom boards to the build environment. This has to be done before pulling in the Zephyr macros
list(APPEND BOARD_ROOT ../..)

macro(app_set_runner_args)
    board_runner_args(dfu-util "--dfuse-modifiers=force:mass-erase")
    board_runner_args(pyocd "--erase")
    board_runner_args(nrfjprog "--erase")
endmacro()

find_package(Zephyr REQUIRED HINTS $ENV{ZEPHYR_BASE})
project(blinky)

# Options source from https://best.openssf.org/Compiler-Hardening-Guides/Compiler-Options-Hardening-Guide-for-C-and-C++.html
if (CMAKE_C_COMPILER_ID STREQUAL "GNU")
    add_compile_options(-O2 -Wall -Wformat -Wformat=2 -Wconversion -Wimplicit-fallthrough)
    add_compile_options(-Werror=format-security)
    add_compile_options(-U_FORTIFY_SOURCE -D_FORTIFY_SOURCE=3)
    add_compile_options(-D_GLIBCXX_ASSERTIONS)
    add_compile_options(-fstrict-flex-arrays=3)
    add_compile_options(-fstack-clash-protection -fstack-protector-strong)
    add_compile_options(-Wl,-z,nodlopen -Wl,-z,noexecstack)
    add_compile_options(-Wl,-z,relro -Wl,-z,now)
    add_compile_options(-Wl,--as-needed -Wl,--no-copy-dt-needed-entries)
endif()

target_sources(app PRIVATE src/main.cpp)
```

## prj.conf
```kconfig
# GLOBAL CONFIGURATIONS
#
# Enable C++ support at C++20 standards level, C at C23 standards, set the
# -Og compiler flag, and warn if any deprecated or experimental features
# are used.
CONFIG_CPP=y
CONFIG_STD_CPP20=y
CONFIG_STD_C23=y
CONFIG_DEBUG_OPTIMIZATIONS=y
CONFIG_WARN_EXPERIMENTAL=y
CONFIG_WARN_DEPRECATED=y

# GPIO
#
# Turn on the GPIO subsystem. This is needed for nearly everything else.
CONFIG_GPIO=y

# LOGGING
#
# Turn on logging in deferred mode. This means it won't log immediately, but
# instead queue them up into a 2k buffer. Enable the runtime filtering
# subsystem, and redirect printk() calls to the logging subsystem.
CONFIG_LOG=y
CONFIG_LOG_MODE_DEFERRED=y
CONFIG_LOG_RUNTIME_FILTERING=y
CONFIG_LOG_BUFFER_SIZE=2048
CONFIG_LOG_PRINTK=y

# USB SUBSYSTEM
# Enable the USB stack at boot, and set the VID/PID to testing ids from
# pid.codes (https://pid.codes/1209/0001/). Set the device product string
# and disable the USB CDC ACM stack's internal logging because it can cause
# conflicts with other things.
CONFIG_USB_DEVICE_STACK=y
CONFIG_USB_DEVICE_INITIALIZE_AT_BOOT=n
CONFIG_USB_DEVICE_VID=0x1209
CONFIG_USB_DEVICE_PID=0x0001
CONFIG_USB_DEVICE_PRODUCT="Zephyr USB console sample"
CONFIG_USB_CDC_ACM_LOG_LEVEL_OFF=y

# GENERAL CONSOLE
#
# Enable the serial console, the UART controls, and RTS/CTS controls on the
# UART.
CONFIG_SERIAL=y
CONFIG_CONSOLE=y
CONFIG_UART_CONSOLE=y
CONFIG_UART_LINE_CTRL=y

# Binary descriptors
#
# Turn on binary descriptors support, and ensure that it automatically defines
# the build datetime string in ISO 8601 format.
CONFIG_BINDESC=y
CONFIG_BINDESC_DEFINE=y
CONFIG_BINDESC_DEFINE_BUILD_TIME=y
CONFIG_BINDESC_BUILD_DATE_TIME_STRING=y

# NON-VOLATILE STORAGE (NVS)
#
# Turn on NVS and flas support, and enable debug logging for NVS. Flip the bit
# in the MCU that allows it to write to flash while running the application.
CONFIG_FLASH=y
CONFIG_NVS=y
CONFIG_NVS_LOG_LEVEL_DBG=y
CONFIG_MPU_ALLOW_FLASH_WRITE=y

# RANDOMNESS
#
# Enable the on-chip entropy generator, which is used to feed the internal
# RNG.
CONFIG_ENTROPY_GENERATOR=y

# INPUT MANAGEMENT
#
# Turn on the input subsystem. This will cause input devices to general event
# streams that we can handle.
CONFIG_INPUT=y
```

## boards/stm32g474_core.overlay
```dts
#include <zephyr/dt-bindings/input/input-event-codes.h>

/delete-node/ &storage_partition;

/ {
    flash0 {
        partitions {
            storage_partition: partition@7f000 {
                label = "storage";
                reg = <0x0007f000 DT_SIZE_K(4)>;
            };
        };
    };
};
```

## src/main.c
```c
/**
 * @file main.c
 * @brief A somewhat complicated example of blinking an LED in Zephyr with some logging over a faux USB serial port.
 *
 * A few of the things that are demonstrsated are GPIO, logging, USB, random numbers, and finally NVS storage for a
 * reboot counter.
 */
#include <stdio.h>
#include <zephyr/bindesc.h>
#include <zephyr/device.h>
#include <zephyr/kernel.h>
#include <zephyr/drivers/gpio.h>
#include <zephyr/drivers/uart.h>
#include <zephyr/drivers/flash.h>
#include <zephyr/fs/nvs.h>
#include <zephyr/logging/log.h>
#include <zephyr/random/random.h>
#include <zephyr/storage/flash_map.h>
#include <zephyr/usb/usb_device.h>


LOG_MODULE_REGISTER(main);

/// Minimum time to sleep between state changes in milliseconds
#define BASE_SLEEP_TIME_MS    100
/// Maximum time to sleep between blinks is BASE_SLEEP_TIME_MS + MAX_SLEEP_TIME_MS
#define MAX_SLEEP_TIME_MS   1001

/// Devicetree identifier alias for the LED to blink
#define LED0_NODE DT_ALIAS(led0)

#define NVS_PARTITION storage_partition
#define NVS_PARTITION_DEVICE FIXED_PARTITION_DEVICE(NVS_PARTITION)
#define NVS_PARTITION_OFFSET FIXED_PARTITION_OFFSET(NVS_PARTITION)
#define NVS_DATA_REBOOT_COUNT_ID 1

int nvs_initialize(struct nvs_fs *fs) {
    struct flash_pages_info page_info; //< Page info for NVS
    int ret;                           //< Default return collector

    /* Define the NFS filesystem */
    fs->flash_device = NVS_PARTITION_DEVICE;
    if (!device_is_ready(fs->flash_device)) {
        LOG_ERR("Flash device not ready");
        return -1;
    } else {
        LOG_INF("Flash device ready");
    }
    fs->offset = NVS_PARTITION_OFFSET;
    ret = flash_get_page_info_by_offs(fs->flash_device, fs->offset, &page_info);
    if (ret > 0) {
        LOG_ERR("Failed to get page info for NVS (return = %d)", ret);
        return -1;
    }
    fs->sector_size = page_info.size;
    fs->sector_count = 2U;

    ret = nvs_mount(fs);
    if (ret > 0) {
        LOG_ERR("Failed to mount NVS (return = %d)", ret);
        return -1;
    }
    return 0;
}

/**
 * Generate a random delay for use later
 *
 * @return random delay between 0 and 999
 */
uint16_t random_delay_get(void) {
    uint32_t rand_val = sys_rand32_get();
    return (uint16_t) (rand_val % MAX_SLEEP_TIME_MS) + BASE_SLEEP_TIME_MS;
}

int main(void) {
    int ret;                                                                   //< General return value collector
    const struct device *const dev = DEVICE_DT_GET(DT_CHOSEN(zephyr_console)); //< UART for the console device
    uint32_t dtr = 0U;                                                         //< DTR status
    uint32_t reboot_count = 0U;                                                //< Reboot counter
    static struct nvs_fs fs;                                                   //< NVS filesystem
    static const struct gpio_dt_spec led = GPIO_DT_SPEC_GET(LED0_NODE, gpios); //< Build error w/o LED defined

    /*
     * Initialize the console. Bring up the USB stack, and then wait for a connection, sleeping to give other threads
     * a chance to execute.
     */
    if (usb_enable(NULL) != 0) {
        return 0;
    }

    while (!dtr) {
        uart_line_ctrl_get(dev, UART_LINE_CTRL_DTR, &dtr);
        k_sleep(K_MSEC(250));
    }

    LOG_INF("Greetings developer! (%s @ %s)", CONFIG_BOARD, BINDESC_GET_STR(build_date_time_string));

    ret = nvs_initialize(&fs);
    if (ret < 0) {
        LOG_ERR("Failed to initialize NVS");
        return 0;
    }

    /* Get the reboot count */
    ret = nvs_read(&fs, NVS_DATA_REBOOT_COUNT_ID, &reboot_count, sizeof(reboot_count));
    if (ret > 0) {
        LOG_INF("Reboot count: %d at id=%d", reboot_count, NVS_DATA_REBOOT_COUNT_ID);
        reboot_count++;
        LOG_INF("Setting reboot count to %d at id=%d", reboot_count, NVS_DATA_REBOOT_COUNT_ID);
        (void) nvs_write(&fs, NVS_DATA_REBOOT_COUNT_ID, &reboot_count, sizeof(reboot_count));
        // XXX Do something with return
    } else {
        LOG_INF("No reboot count found at id=%d. Initializing to 0.", NVS_DATA_REBOOT_COUNT_ID);
        (void) nvs_write(&fs, NVS_DATA_REBOOT_COUNT_ID, &reboot_count, sizeof(reboot_count));
        // XXX Do something with return
    }

    if (!gpio_is_ready_dt(&led)) {
        LOG_ERR("LED device not ready");
        return 0;
    }

    ret = gpio_pin_configure_dt(&led, GPIO_OUTPUT_ACTIVE);
    if (ret < 0) {
        LOG_ERR("Failed to configure LED pin");
        return 0;
    }

    LOG_INF("Starting the blinking loop");

    while (1) {
        ret = gpio_pin_toggle_dt(&led);

        if (ret != 0) {
            return 0;
        }
        uint16_t delay = random_delay_get();
        LOG_INF("LED state: %s (%dms)", gpio_pin_get_dt(&led) ? "ON" : "OFF", delay);
        k_msleep(delay);
    }
    return 0;
}
```

## src/main.cpp
```c
/**
 * @file main.cpp
 * @brief A somewhat complicated example of blinking an LED in Zephyr with some logging over a faux USB serial port.
 *
 * A few of the things that are demonstrsated are GPIO, logging, USB, random numbers, and finally NVS storage for a
 * reboot counter.
 */
#include <zephyr/bindesc.h>
#include <zephyr/device.h>
#include <zephyr/kernel.h>
#include <zephyr/drivers/gpio.h>
#include <zephyr/drivers/uart.h>
#include <zephyr/drivers/flash.h>
#include <zephyr/fs/nvs.h>
#include <zephyr/input/input.h>
#include <zephyr/logging/log.h>
#include <zephyr/random/random.h>
#include <zephyr/storage/flash_map.h>
#include <zephyr/usb/usb_device.h>


LOG_MODULE_REGISTER(main);

/// Minimum time to sleep between state changes in milliseconds
#define BASE_SLEEP_TIME_MS 100

/// Maximum time to sleep between blinks is BASE_SLEEP_TIME_MS + MAX_SLEEP_TIME_MS
#define MAX_SLEEP_TIME_MS 1001

/// Devicetree identifier alias for the LED to blink
#define LED0_NODE DT_ALIAS(led0)

#define NVS_PARTITION storage_partition
#define NVS_PARTITION_DEVICE FIXED_PARTITION_DEVICE(NVS_PARTITION)
#define NVS_PARTITION_OFFSET FIXED_PARTITION_OFFSET(NVS_PARTITION)
#define NVS_DATA_REBOOT_COUNT_ID 1

static void input_cb([[maybe_unused]] input_event *event, [[maybe_unused]] void *user_data) {
    LOG_INF("Got input event: %d %d %s", event->type, event->code, (event->value == 1) ? "DOWN" : "UP");
}

INPUT_CALLBACK_DEFINE(NULL, input_cb, NULL);

/**
 *
 * @param fs nvs_fs struct to be initialized
 * @return -1 on error, 0 otherwise
 */
int nvs_initialize(nvs_fs *fs) {
    flash_pages_info page_info = {}; //< Page info for NVS
    int ret;                                //< Default return collector

    /* Define the NFS filesystem */
    fs->flash_device = NVS_PARTITION_DEVICE;
    if (!device_is_ready(fs->flash_device)) {
        LOG_ERR("Flash device not ready");
        return -1;
    } else {
        LOG_INF("Flash device ready");
    }
    fs->offset = NVS_PARTITION_OFFSET;
    ret = flash_get_page_info_by_offs(fs->flash_device, fs->offset, &page_info);
    if (ret > 0) {
        LOG_ERR("Failed to get page info for NVS (return = %d)", ret);
        return -1;
    }
    fs->sector_size = page_info.size;
    fs->sector_count = 2U;

    ret = nvs_mount(fs);
    if (ret > 0) {
        LOG_ERR("Failed to mount NVS (return = %d)", ret);
        return -1;
    }
    return 0;
}

/**
 * Generate a random delay for use later
 *
 * @return random delay between 0 and 999
 */
uint16_t random_delay_get() {
    const uint32_t rand_val = sys_rand32_get(); // Const only for this function call
    return static_cast<uint16_t>(rand_val % MAX_SLEEP_TIME_MS) + BASE_SLEEP_TIME_MS;
}

int main(void) {
    int ret;                                                                //< General return value collector
    const device *dev = DEVICE_DT_GET(DT_CHOSEN(zephyr_console));     //< UART for the console device
    uint32_t dtr = 0U;                                                      //< DTR status
    uint32_t reboot_count = 0U;                                             //< Reboot counter
    static nvs_fs fs;                                                       //< NVS filesystem
    static constexpr gpio_dt_spec led = GPIO_DT_SPEC_GET(LED0_NODE, gpios); //< Build error w/o LED defined

    /*
     * Initialize the console. Bring up the USB stack, and then wait for a connection, sleeping to give other threads
     * a chance to execute.
     */
    if (usb_enable(nullptr) != 0) {
        return 0;
    }

    while (!dtr) {
        uart_line_ctrl_get(dev, UART_LINE_CTRL_DTR, &dtr);
        k_sleep(K_MSEC(250));
    }

    LOG_INF("Greetings developer! (%s @ %s)", CONFIG_BOARD, BINDESC_GET_STR(build_date_time_string));

    ret = nvs_initialize(&fs);
    if (ret < 0) {
        LOG_ERR("Failed to initialize NVS");
        return 0;
    }

    /* Get the reboot count */
    ret = nvs_read(&fs, NVS_DATA_REBOOT_COUNT_ID, &reboot_count, sizeof(reboot_count));
    if (ret > 0) {
        LOG_INF("Reboot count: %d at id=%d", reboot_count, NVS_DATA_REBOOT_COUNT_ID);
        reboot_count++;
        LOG_INF("Setting reboot count to %d at id=%d", reboot_count, NVS_DATA_REBOOT_COUNT_ID);
        (void) nvs_write(&fs, NVS_DATA_REBOOT_COUNT_ID, &reboot_count, sizeof(reboot_count));
        // XXX Do something with return
    } else {
        LOG_INF("No reboot count found at id=%d. Initializing to 0.", NVS_DATA_REBOOT_COUNT_ID);
        (void) nvs_write(&fs, NVS_DATA_REBOOT_COUNT_ID, &reboot_count, sizeof(reboot_count));
        // XXX Do something with return
    }

    if (!gpio_is_ready_dt(&led)) {
        LOG_ERR("LED device not ready");
        return 0;
    }

    ret = gpio_pin_configure_dt(&led, GPIO_OUTPUT_ACTIVE);
    if (ret < 0) {
        LOG_ERR("Failed to configure LED pin");
        return 0;
    }

    LOG_INF("Starting the blinking loop");

    while (true) {
        ret = gpio_pin_toggle_dt(&led);

        if (ret != 0) {
            return 0;
        }
        uint16_t delay = random_delay_get();
        LOG_INF("LED state: %s (%dms)", gpio_pin_get_dt(&led) ? "ON" : "OFF", delay);
        k_msleep(delay);
    }
    return 0;
}
```
